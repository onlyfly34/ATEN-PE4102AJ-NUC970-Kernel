## arch/arm/configs/pe4102aj_defconfig
```kconfig
CONFIG_LOCALVERSION="-pe4102aj"
# CONFIG_LOCALVERSION_AUTO is not set
CONFIG_KERNEL_XZ=y
CONFIG_SYSVIPC=y
CONFIG_POSIX_MQUEUE=y
CONFIG_NO_HZ_IDLE=y
CONFIG_HIGH_RES_TIMERS=y
CONFIG_PREEMPT=y
CONFIG_LOG_BUF_SHIFT=15
CONFIG_NAMESPACES=y
# CONFIG_UTS_NS is not set
# CONFIG_PID_NS is not set
CONFIG_BLK_DEV_INITRD=y
CONFIG_CC_OPTIMIZE_FOR_SIZE=y
CONFIG_SYSFS_SYSCALL=y
CONFIG_EXPERT=y
# CONFIG_ARCH_MULTI_V7 is not set
CONFIG_ARCH_NUC970=y
CONFIG_AEABI=y
CONFIG_OABI_COMPAT=y
CONFIG_ARM_APPENDED_DTB=y
CONFIG_ARM_ATAG_DTB_COMPAT=y
CONFIG_ARM_ATAG_DTB_COMPAT_CMDLINE_EXTEND=y
# CONFIG_SUSPEND is not set
# CONFIG_SECCOMP is not set
# CONFIG_BLOCK_LEGACY_AUTOLOAD is not set
# CONFIG_BLK_DEV_WRITE_MOUNTED is not set
# CONFIG_MQ_IOSCHED_DEADLINE is not set
# CONFIG_MQ_IOSCHED_KYBER is not set
# CONFIG_SLAB_MERGE_DEFAULT is not set
# CONFIG_COMPAT_BRK is not set
CONFIG_NET=y
CONFIG_PACKET=y
CONFIG_PACKET_DIAG=y
CONFIG_UNIX=y
CONFIG_UNIX_DIAG=y
CONFIG_INET=y
CONFIG_IP_MULTICAST=y
CONFIG_NETFILTER=y
# CONFIG_NETFILTER_INGRESS is not set
CONFIG_NETFILTER_XTABLES_LEGACY=y
CONFIG_NETFILTER_XT_MATCH_IPRANGE=y
CONFIG_NETFILTER_XT_MATCH_MAC=y
CONFIG_IP_NF_IPTABLES=y
# CONFIG_IP_NF_MANGLE is not set
CONFIG_IP6_NF_IPTABLES=y
# CONFIG_IP6_NF_MANGLE is not set
# CONFIG_WIRELESS is not set
CONFIG_UEVENT_HELPER=y
CONFIG_DEVTMPFS=y
CONFIG_DEVTMPFS_MOUNT=y
# CONFIG_STANDALONE is not set
# CONFIG_PREVENT_FIRMWARE_BUILD is not set
CONFIG_MTD=y
CONFIG_MTD_BLOCK=y
CONFIG_MTD_SPI_NOR=y
# CONFIG_MTD_SPI_NOR_USE_4K_SECTORS is not set
CONFIG_BLK_DEV_RAM=y
CONFIG_NUC970_ETIMER=y
CONFIG_SCSI=y
# CONFIG_SCSI_PROC_FS is not set
CONFIG_BLK_DEV_SD=y
# CONFIG_SCSI_LOWLEVEL is not set
CONFIG_NETDEVICES=y
CONFIG_NUC970_EMAC=y
CONFIG_ICPLUS_PHY=y
# CONFIG_WLAN is not set
# CONFIG_INPUT_KEYBOARD is not set
# CONFIG_INPUT_MOUSE is not set
# CONFIG_SERIO is not set
# CONFIG_LEGACY_TIOCSTI is not set
# CONFIG_LDISC_AUTOLOAD is not set
CONFIG_SERIAL_NUC970=y
CONFIG_SERIAL_NUC970_CONSOLE=y
# CONFIG_HW_RANDOM is not set
# CONFIG_DEVPORT is not set
CONFIG_NUC970_DMA_PROXY=y
CONFIG_SPI=y
CONFIG_SPI_NUC970=y
CONFIG_PINCTRL_SINGLE=y
CONFIG_GPIO_SYSFS=y
# CONFIG_HWMON is not set
# CONFIG_HID_SUPPORT is not set
CONFIG_USB=y
CONFIG_USB_EHCI_HCD=y
CONFIG_USB_OHCI_HCD=y
CONFIG_USB_STORAGE=y
CONFIG_USB_SERIAL=y
CONFIG_USB_SERIAL_PL2303=y
CONFIG_RTC_CLASS=y
CONFIG_RTC_DRV_NUC970=y
CONFIG_DMADEVICES=y
CONFIG_NUC970_GDMA=y
# CONFIG_VIRTIO_MENU is not set
# CONFIG_VHOST_MENU is not set
# CONFIG_DNOTIFY is not set
CONFIG_MSDOS_FS=y
CONFIG_VFAT_FS=y
CONFIG_TMPFS=y
CONFIG_JFFS2_FS=y
CONFIG_CRAMFS=y
CONFIG_CRAMFS_MTD=y
CONFIG_NLS_CODEPAGE_437=y
CONFIG_NLS_ISO8859_1=y
CONFIG_CRYPTO=y
CONFIG_CRYPTO_USER=y
CONFIG_CRYPTO_SELFTESTS=y
CONFIG_CRYPTO_NULL=y
CONFIG_CRYPTO_AES=y
CONFIG_CRYPTO_DES=y
CONFIG_CRYPTO_CBC=y
CONFIG_CRYPTO_CTR=y
CONFIG_CRYPTO_SEQIV=y
CONFIG_CRYPTO_MD5=y
CONFIG_CRYPTO_SHA1=y
CONFIG_CRYPTO_SHA256=y
CONFIG_CRYPTO_USER_API_HASH=y
CONFIG_CRYPTO_USER_API_SKCIPHER=y
CONFIG_CRYPTO_USER_API_RNG=y
CONFIG_CRYPTO_USER_API_AEAD=y
CONFIG_CRYPTO_DEV_NUC970=y
CONFIG_PRINTK_TIME=y
# CONFIG_SYMBOLIC_ERRNAME is not set
# CONFIG_SECTION_MISMATCH_WARN_ONLY is not set
CONFIG_MAGIC_SYSRQ=y
CONFIG_DEBUG_MEMORY_INIT=y
CONFIG_DEBUG_LL=y
CONFIG_EARLY_PRINTK=y
# CONFIG_RUNTIME_TESTING_MENU is not set
```

## arch/arm/mach-nuc970/Kconfig
```kconfig
# SPDX-License-Identifier: GPL-2.0-only
menuconfig ARCH_NUC970
	bool "Nuvoton NUC970/NUC977 (ARM926EJ-S)"
	depends on ARCH_MULTI_V5 && CPU_LITTLE_ENDIAN
	select CPU_ARM926T
	select NUC970_AIC
	select NUC970_TIMER
	select COMMON_CLK
	select PINCTRL
	select GPIOLIB
	help
	  Support for the Nuvoton NUC970 family (NUC970/NUC972/NUC977) of
	  ARM926EJ-S based SoCs, as used in the ATEN PE4102 PDU.

config NUC970_DECOMP_WDI
	bool "Feed the PE4102 external watchdog during kernel decompression"
	depends on ARCH_NUC970 && KERNEL_LZMA
	help
	  The ATEN PE4102 has an external watchdog fed by toggling PB12.
	  LZMA decompression of the zImage takes longer than its timeout,
	  so toggle PB12 from the LZMA range decoder. Board specific: it
	  writes GPIOB DATAOUT at its physical address. Say N for other
	  NUC970 boards.
```

## drivers/clk/nuvoton/Kconfig
```kconfig
# SPDX-License-Identifier: GPL-2.0
# common clock support for Nuvoton SoC family.

config COMMON_CLK_NUVOTON
	bool "Nuvoton clock controller common support"
	depends on ARCH_MA35 || ARCH_NUC970 || COMPILE_TEST
	default ARCH_MA35 || ARCH_NUC970
	help
	  Say y here to enable common clock controller for Nuvoton platforms.

if COMMON_CLK_NUVOTON

config CLK_MA35D1
	bool "Nuvoton MA35D1 clock controller support"
	default ARCH_MA35
	help
	  Build the clock controller driver for MA35D1 SoC.

config CLK_NUC970
	bool "Nuvoton NUC970 clock controller support"
	depends on ARM || COMPILE_TEST
	default ARCH_NUC970
	help
	  Build the clock controller driver for NUC970 family SoCs.

endif
```

## drivers/net/ethernet/nuvoton/Kconfig
```kconfig
# SPDX-License-Identifier: GPL-2.0-only
config NET_VENDOR_NUVOTON
	bool "Nuvoton devices"
	default y
	depends on ARCH_NUC970 || COMPILE_TEST
	help
	  If you have a network (Ethernet) card belonging to this class, say Y.

if NET_VENDOR_NUVOTON

config NUC970_EMAC
	tristate "Nuvoton NUC970 Ethernet MAC"
	depends on OF && COMMON_CLK && HAS_DMA
	select PHYLIB
	select MDIO_BUS
	select OF_MDIO
	help
	  Driver for the 10/100 Ethernet MACs of Nuvoton NUC970 family SoCs.

endif # NET_VENDOR_NUVOTON
```
